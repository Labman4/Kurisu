## main/Kconfig.projbuild
```kconfig
menu "OTA Configuration"

    config FIRMWARE_UPGRADE_URL
        string "Firmware Upgrade URL"
        default "https://nrm5rra2wy7z.objectstorage.ap-tokyo-1.oci.customer-oci.com/p/NCut9Hlgp7HTqjWG4be3Z8gDhktFgLSVWS0ne9bp7X2buM7cMpIZiUZLSAT1dN6e/n/nrm5rra2wy7z/b/ota/o/Kurisu.bin"
        help
            URL of server which hosts the firmware image.

    config SKIP_COMMON_NAME_CHECK
        bool "Skip server certificate CN fieldcheck"
        default n
        help
            This allows you to skip the validation of OTA server certificate CN field.

    config SKIP_VERSION_CHECK
        bool "Skip firmware version check"
        default n
        help
            This allows you to skip the firmware version check.

    config RECV_TIMEOUT
        int "OTA Receive Timeout"
        default 10000
        help
            Maximum time for reception

    config ENABLE_PARTIAL_HTTP_DOWNLOAD
        bool "Enable partial HTTP download"
        default n
        help
            This enables use of Range header in esp_https_ota component.
            Firmware image will be downloaded over multiple HTTP requests.

    config HTTP_REQUEST_SIZE
        int "HTTP request size"
        default MBEDTLS_SSL_IN_CONTENT_LEN
        depends on ENABLE_PARTIAL_HTTP_DOWNLOAD
        help
            This options specifies HTTP request size. Number of bytes specified
            in this option will be downloaded in single HTTP request.
endmenu
```

## sdkconfig.defaults
```kconfig
CONFIG_LWIP_TCP_SND_BUF_DEFAULT=65535
CONFIG_LWIP_TCP_WND_DEFAULT=65535
CONFIG_LWIP_TCP_RECVMBOX_SIZE=64
CONFIG_LWIP_UDP_RECVMBOX_SIZE=64
CONFIG_LWIP_TCPIP_RECVMBOX_SIZE=64

CONFIG_ESPTOOLPY_FLASHMODE_QIO=y
CONFIG_ESPTOOLPY_FLASHFREQ_80M=y

CONFIG_ESP32S3_INSTRUCTION_CACHE_32KB=y
CONFIG_ESP32S3_INSTRUCTION_CACHE_LINE_32B=y

CONFIG_PARTITION_TABLE_CUSTOM=y
CONFIG_PARTITION_TABLE_CUSTOM_FILENAME="partitions.csv"
CONFIG_PARTITION_TABLE_FILENAME="partitions.csv"
CONFIG_PARTITION_TABLE_OFFSET=0x8000
CONFIG_FATFS_VFS_FSTAT_BLKSIZE=4096
```
